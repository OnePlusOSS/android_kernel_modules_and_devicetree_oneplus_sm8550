/dts-v1/;
/plugin/;
#include <dt-bindings/oplus/hw-id.h>
#include "../kalama-audio-mtp.dts"
#include "kalama-audio-overlay-common.dtsi"
#include "zonda-22635-audio-kalama-overlay.dtsi"

/ {
    model = "Qualcomm Technologies, Inc. Kalama MTP,zonda";

    oplus,project-id = <22635 22714 23603 23667>;
};
