/dts-v1/;
/plugin/;
#include <dt-bindings/oplus/hw-id.h>
#include "../kalama-audio-mtp.dts"
#include "kalama-audio-overlay-common.dtsi"
#include "xigua-22851-audio-kalama-overlay.dtsi"

/ {
    model = "Qualcomm Technologies, Inc. Kalama MTP,xigua";

    oplus,project-id = <22851>;
};
