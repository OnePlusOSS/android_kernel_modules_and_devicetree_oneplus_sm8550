/dts-v1/;
/plugin/;

#include "kalama-ese-common.dtsi"

/ {
	model = "Qualcomm Technologies, Inc. Kalama CDP";
	compatible = "qcom,kalama-cdp", "qcom,kalama", "qcom,cdp";
	qcom,msm-id = <519 0x10000>, <536 0x10000>;
	qcom,board-id = <0x02010001 0>;
};
