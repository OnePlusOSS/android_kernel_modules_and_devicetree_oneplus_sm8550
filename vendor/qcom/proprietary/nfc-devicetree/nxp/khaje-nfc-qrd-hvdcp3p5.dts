/dts-v1/;
/plugin/;

#include "khaje-nfc-common.dtsi"
/ {
	model = "Qualcomm Technologies, Inc. KHAJE QRD HVDCP3P5";
	compatible = "qcom,khaje-qrd", "qcom,khaje", "qcom,qrd";
	qcom,msm-id = <518 0x10000>;
	qcom,board-id = <0x1010B 0>;
};
