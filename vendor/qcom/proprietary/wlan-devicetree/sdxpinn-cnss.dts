/dts-v1/;
/plugin/;

#include "sdxpinn-cnss.dtsi"

/ {
	model = "Qualcomm Technologies, Inc. SDXPINN SoC";
	compatible = "qcom,sdxpinn";
	qcom,msm-id = <556 0x10000>, <580 0x10000>;
	qcom,board-id = <0 0>;
};
