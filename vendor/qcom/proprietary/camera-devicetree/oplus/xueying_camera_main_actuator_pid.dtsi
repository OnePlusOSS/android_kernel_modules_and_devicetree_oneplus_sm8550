&actuator_triple_wide {
	pid_version = <0x20>;
	pid_register = /bits/ 8 <0x0B 0x82
	0x0A 0x00
	0x0E 0x8C
	0x0F 0xC1
	0x08 0x1E
	0x09 0x20
	0x10 0x35
	0x11 0x41
	0x12 0x6E
	0x13 0x22
	0x14 0x14
	0x15 0x00
	0x16 0x20
	0x17 0x3C
	0x18 0xAA
	0x1A 0x00
	0x1B 0x30
	0x1C 0xBE
	0x1D 0xDC
	0x1E 0xE1
	0x1F 0x14
	0x20 0x21
	0x21 0x29
	0x22 0x3C
	0x23 0xB9
	0x24 0x9C
	0x25 0x07
	0x26 0xC3
	0x27 0xBC
	0x28 0x7C
	0x29 0x0B
	0x2A 0x3C
	0x2B 0x9A
	0x2C 0x84
	0x2D 0xC9
	0x2E 0x3E
	0x2F 0xD6
	0x30 0x00
	0x31 0x3D
	0x32 0x00
	0x33 0x28
	0x34 0xC0
	0x35 0x46
	0x36 0xC7
	0x3C 0x50
	0x3D 0xC5
	0x52 0x14
	0x53 0x50
	0x54 0x14
	0x55 0x32
	0x50 0x46
	0x51 0xD8
	0x56 0x23
	0x57 0xB4
	0x58 0x40
	0x59 0x0B
	0x5A 0x00
	0x5B 0x02
	0x5C 0x32
	0x5E 0x00
	0x5F 0x00
	0xC4 0x00
	>;
};