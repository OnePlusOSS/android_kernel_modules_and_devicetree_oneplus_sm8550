/*Fullchip

//dtype, last, wait, ip, opt, dlen
//sys*/
//commit: b87c0b361dd272e250768a39e6fc173966be32c6
//build : 2023-03-27 16:22:37
&soc {
pxlw {
mdss_iris_cfg_zonda_tianma_nt37705_1240_2772_dsc_cmd: pxlw,mdss_iris_cfg_zonda_tianma_nt37705_1240_2772_dsc_cmd {
  pxlw,platform = <1>;
  pxlw,panel-type = "PANEL_OLED";
  /*low power control: dynamic power gating, ulps low power, analog bypass */
  pxlw,low-power = [01 01 02];
  /* virtual channel enable: PT, FRC */
  pxlw,virtual-channel-enable = [00 00];
  pxlw,virtual-channel-id = [00 02 03];
  pxlw,chip-ver = <0x6935>;
  pxlw,pkt-payload-size = <228>;
  pxlw,min-color-temp = <2500>;
  pxlw,max-color-temp = <10000>;
  /*first value represents lightup, second is pq update*/
  /*0: non-embedded, 1: embedded-no-ma, 2: embedded-ma*/
  pxlw,dsi-trans-mode = [00 01];
  /*the 3 groups represent 3 trans modes, non-embedded, embedded-no-ma, embedded-ma*/
  /*in non-embedded mode, the value must be a multiple of 256*/
  /*in embedded mode, the value must be a multiple of (pkt-payload-size + 8)*/
  pxlw,dsi-trans-len = <0x1000 0x400>, <0x0 0x0>, <0x0 0x0>;
  /* 0: DSI_VIDEO_MODE, 1: DSI_CMD_MODE */
  pxlw,iris-tx-mode = /bits/ 8 <1>;
  pxlw,panel-dimming-brightness = <4095>;
  pxlw,panel-te = <60>;
  pxlw,ap-te = <60>;
  pxlw,esd-ctrl = <7>;
  pxlw,timing-cmd-map = [02 01 00 03 FF];
  pxlw,master-timing-cmd-map = [00 00 00 00 00];
  pxlw,frc-dsc-init-delay= <4047>;
  pxlw,cmd-param-from-firmware = <1>;
  pxlw,iris-lightup-sequence-pre0= [
    /*sys*/
    00  a0  00
    00  00  00
    00  06  00
  ];
  pxlw,iris-lightup-sequence-pre1= [
    /*sys*/
    00  a0  00
    00  00  00
    00  06  00
  ];
  pxlw,iris-lightup-sequence-cont-splash= [
    /* rx ctrl */
    01  f0  00
    /* tx */
    02  01  00
    02  00  00
    /* dtg */
    05  00  00
    05  f0  00
    /*dport*/
    04  f0  00
    04  80  00
    /*pwil*/
    03  00  00
    03  01  00
    03  02  00
    03  03  00
    03  04  00
    03  80  00
    23  00  00
    23  80  00
  ];
  pxlw,iris-lightup-sequence= [
    /* sys */
    00  f4  01
    /* rx ctrl */
    01  f0  01
    01  01  00
    01  02  01
    /* rx1 ctrl */
    21  f1  01
    21  f0  01
    /*tx*/
    02  01  01
    02  03  00
    02  04  01
    02  00  00
    /*dtg*/
    05  00  00
    05  f1  00
    05  f0  00
    /*gamma,65-bin*/
    86  00  01
    /*3dlut,17-bin*/
    81  01  01
    81  04  01
    81  05  01
    81  06  01
    81  08  01
    81  09  01
    81  0a  01
    81  0b  01
    81  0c  01
    81  0d  01
    /*dpp pre_lut*/
    92  10  01
    92  00  01
    /*dpp demura lut*/
    8d  00  01
    8d  10  01
    8d  20  01
    8d  30  01
    /* hdr lut */
    82  01  01
    82  11  01
    82  21  01
    82  31  01
    82  40  01
    82  50  01
    82  60  01
    82  70  01
    82  80  01
    82  90  01
    82  a0  01
    82  b0  01
    82  c0  01
    /*blending lut */
    93  00  01
    93  20  01
    93  30  01
    /* scaler1d filter lut */
    83  00  01
    83  40  01
    83  80  01
    83  c0  01
    8e  00  01
    8e  40  01
    8e  80  01
    8e  c0  01
    8a  00  01
    8a  40  01
    8a  80  01
    8a  c0  01
    8f  00  01
    8f  40  01
    8f  80  01
    8f  c0  01
    /* SR filter */
    94  00  01
    /*dport*/
    04  f0  01
    04  e0  01
    04  80  00
    /*blending*/
    2e  f0  01
    2e  40  01
    2e  50  01
    2e  60  01
    2e  90  01
    2e  80  01
    /* scaler1d */
    0b  f0  01
    2f  f0  01
    /* pwil */
    03  f0  01
    03  90  01
    03  d0  01
    03  a0  01
    03  60  01
    03  b0  01
    03  70  01
    03  50  01
    03  40  01
    03  81  01
    03  80  01
    03  c0  01
    03  df  01
    03  e0  01
    03  e3  01
    03  e1  01
    /* psr_mif */
    2d  f0  01
    2d  80  01
    /* pwil_v11 */
    23  f0  01
    /* dsc dec aux */
    37  f0  01
    37  90  01
    37  80  00
    /* osd_comp */
    2a  f0  01
    /* osd_decomp */
    2b  f0  01
    /* dpp  */
    0e  f0  01
    0e  00  01
    0e  10  01
    0e  20  01
    0e  30  01
    0e  51  01
    0e  50  01
    0e  52  01
    0e  60  01
    0e  61  01
    0e  62  01
    0e  63  01
    0e  54  01
    0e  21  01
    0e  40  01
    0e  31  01
    0e  23  01
    0e  32  01
    0e  33  01
    0e  34  01
    0e  a0  01
    0e  90  01
    0e  81  01
    /* dsc */
    07  f0  01
    07  90  01
    07  80  00
    08  f0  01
    08  f1  01
    08  a0  01
    08  b0  01
    24  f1  00
    25  f1  00
    26  f1  00
    38  f1  00
    39  f0  01
    /* ai */
    12  10  01
    12  20  01
    12  30  01
    12  40  01
    12  80  01
    /* hdr */
    09  00  01
    09  10  01
    09  20  01
    09  30  01
    09  40  01
    09  50  01
    09  60  01
    0a  50  01
    09  70  01
    09  90  01
    09  a0  01
    09  b0  01
    09  c0  01
    09  d0  01
    09  e0  01
    0a  00  01
    0a  10  01
    0a  20  01
    0a  30  01
    0a  40  01
    09  80  00
    /*DMA*/
    11  f0  01
    11  d0  01
    11  d1  01
    11  d2  01
    11  d3  01
    11  e1  00
    0e  80  01
    11  e9  00
  ];
  pxlw,iris-fps-switch-sequence= [
    /* sys */
    00  f3  00
    /* mipi tx */
    //02  04  00
    /* blending */
    2e  f0  00
    //2e  20  01
    /* dma */
    //11  e5  00
  ];
  pxlw,iris-fps-clk-switch-sequence= [
    /* sys */
    00  a0  00
    00  f3  00
    00  f6  00
    /* mipi rx */
    01  01  00
    21  f1  01
    /* mipi tx */
    02  04  00
    /* blending */
    2e  f0  00
    //2e  20  01
    /* dma */
    11  e1  00
  ];
  pxlw,iris-pq-default-val= [
    /* sys */
    00  a0
    /* rx */
    01  e0
    /* tx */
    02  00
    /*DTG*/
    05  00
    05  f0
    /*DPORT*/
    04  f0
    04  80
    /* scaler1d */
    0b  f0
    2f  f0
    /* scaler1d filter lut */
    83  00
    83  40
    83  80
    83  c0
    8e  00
    8e  40
    8e  80
    8e  c0
    8a  00
    8a  40
    8a  80
    8a  c0
    8f  00
    8f  40
    8f  80
    8f  c0
    /* SR filter */
    94  00
    /* blending */
    2e  f0
    2e  40
    2e  50
    2e  60
    2e  90
    /* pwil */
    03  f0
    03  d0
    03  a0
    03  60
    03  b0
    03  70
    03  50
    03  40
    03  80
    /* dsc */
    07  f0
    07  90
    07  80
    08  f0
    08  f1
    08  a0
    08  b0
    24  f1
    25  f1
    26  f1
    /* dpp */
    0e  20
    0e  30
    0e  51
    0e  52
    0e  50
    0e  60
    0e  61
    0e  62
    0e  63
    0e  54
    0e  90
    81  00
    92  00
    86  00
    86  10
    86  20
    /* hdr */
    09  00
    09  10
    09  20
    09  30
    09  40
    09  50
    09  60
    09  70
    09  90
    09  a0
    09  b0
    09  c0
    09  d0
    0a  00
    0a  10
    0a  20
    0a  30
    0a  50
    /* hdr lut */
    82  01
    82  11
    /*dpp demura lut*/
    8d  00
    8d  10
    8d  20
    8d  30
    /* ai */
    12  10
    12  20
  ];
  };
  };
};
