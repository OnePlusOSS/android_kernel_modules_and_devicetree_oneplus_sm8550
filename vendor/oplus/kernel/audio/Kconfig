## vendor/oplus/kernel/audio/Kconfig
```kconfig
#
# oplus extend audio codec configuration
#
config SND_SOC_SIA81XX
	tristate "SoC Audio for  SIA81XX PA"
	default n
	help
	  This option enables support for SIA81XX  K PA.

config SND_SOC_OPLUS_PA_MANAGER
	tristate "SoC Audio for PA MANAGER"
	default n
	help
	  This option enables support for PA MANAGER.

config SIA_PA_ALGO
	tristate "Use SIA PA ALGO"
	default n

config HSKEY_BLOCK
	tristate "Block hskey for 1s"
	default n

config OPLUS_MTK_AUDIO_EXT
	tristate "Support oplus audio drv ext"
	default n
	help
	  This adds sipa driver for Mediatek boards
	  that can be used with other platforms
	  Select m if you have such device.
	  If unsure select "N".

config SND_SOC_TFA9873
	tristate "NXP TFA9873 speaker amplifier"
	depends on I2C
	help
	  Config of TFA9873. It is a Smart power
	  amplifier which contain speaker protection,
	  multi-band DRC, equalizer function. It would
	  be set to yes if device with TFA9873 on it.

config SND_SOC_TFA9874
	tristate "NXP TFA9874 speaker amplifier"
	depends on I2C
	help
	  Config of TFA9874. It is a Smart power
	  amplifier which contain speaker protection,
	  multi-band DRC, equalizer function. It would
	  be set to yes if device with TFA9874 on it.

config SND_SOC_OPLUS_TYPEC_SWITCH
	tristate "TypeC Switch for DIO 448x or WAS 7483"
	depends on I2C
	help
	  Config of 4480 or 4483. It is a USB type-C Analog Audio
	  Switch.
```

## vendor/oplus/kernel/boot/Kconfig
```kconfig
# SPDX-License-Identifier: GPL-2.0-only
# Copyright (C) 2018-2022 Oplus. All rights reserved.

source "drivers/soc/oplus/boot/cmdline_parser/Kconfig"
source "drivers/soc/oplus/boot/misc/Kconfig"
source "drivers/soc/oplus/boot/oplus_phoenix/Kconfig"
source "drivers/soc/oplus/boot/oplus_project/Kconfig"
source "drivers/soc/oplus/boot/project_info/Kconfig"
source "drivers/soc/oplus/boot/uboot_log/Kconfig"
```

## vendor/oplus/kernel/boot/uboot_log/Kconfig
```kconfig
# SPDX-License-Identifier: GPL-2.0-only
# Copyright (C) 2018-2020 Oplus. All rights reserved.
config OPLUS_FEATURE_UBOOT_LOG
  bool "oplus system uboot log"
  default n
  help
    define this config to enable QCOM platform uboot log .
```

## vendor/oplus/kernel/cpu/freqqos_monitor/Kconfig
```kconfig
config OPLUS_FEATURE_FREQQOS_MONITOR
	tristate "oplus_freqqos_monitor"
	default n
	help
	  detection for cpufreq qos
```

## vendor/oplus/kernel/cpu/power_diag/Kconfig
```kconfig
config OPLUS_FEATURE_POWER_DIAG
	tristate "config oplus power diag feature"
	default m
	help
		This enables monitoring the cpu load and pm qos
```

## vendor/oplus/kernel/cpu/sched/Kconfig
```kconfig
# SPDX-License-Identifier: GPL-2.0-only
# Copyright (C) 2018-2020 Oplus. All rights reserved.

config OPLUS_FEATURE_PERFORMANCE_SCHED
	bool "config oplus kernel sched feature"
	default y
	help
	  define this config to add oplus kernel sched feature

config OPLUS_FEATURE_SCHED_ASSIST
	tristate "sched assist"
	default n
	help
	  turning sched for ui, render and so on to improve UX

config OPLUS_FEATURE_SF_BOOST
	tristate "sf boost"
	default n
	help
	  When the util of surfaceflinger is greater than 90,
	  prefer to use big core.

config OPLUS_FEATURE_HEALTHINFO
	tristate "config healthinfo"
	default n
	depends on OPLUS_FEATURE_PERFORMANCE_SCHED
	help
	  define this config to init  healthinfo.

config OPLUS_FEATURE_TASK_CPUSTATS
	tristate "task_cpustats"
	default n
	help
	  record cpu status

config OPLUS_FEATURE_SCHED_SPREAD
	bool "sched spread"
	default n
	depends on OPLUS_FEATURE_SCHED_ASSIST
	depends on CGROUP_SCHED
	help
	  This is the uifirst 5.0 feature, which will spread tasks,
	  kick runnable time from task demand.

config OPLUS_FEATURE_TASK_SCHED
	tristate "task_sched"
	default n
	depends on OPLUS_FEATURE_SCHED_ASSIST
	help
	  record task sched info

config OPLUS_FEATURE_TASK_LOAD
	tristate "task_load"
	default n
	depends on OPLUS_FEATURE_SCHED_ASSIST
	help
	  record cpu and task load

config OPLUS_SCHED_MT6895
	bool "mt6895 specific sched feature"
	default n
	help
	  the difference between the mainline currently is whether to
	  skip the CPU where the ux task is located when the RT task
	  selects a new cpu core.
	  rt tasks have "affinity with" prev running cpu, this only
	  takes effect when a new core is selected.

config OPLUS_FEATURE_CPU_JANKINFO
	tristate "config cpu_jankinfo"
	default n
	depends on OPLUS_FEATURE_PERFORMANCE_SCHED
	help
	  define this config to enable cpu jankinfo.

config OPLUS_FEATURE_FRAME_BOOST
	tristate "frame boost"
	default n
	depends on OPLUS_FEATURE_PERFORMANCE_SCHED
	help
	  This moduler is used to improve frame missing by aggregating key-threads in one group,
	  then adjust cpu frequence and placement.

config OPLUS_FEATURE_BAN_APP_SET_AFFINITY
	bool "config ban app set affinity"
	default n
	help
	  ban app set affinity
```

## vendor/oplus/kernel/cpu/thermal/Kconfig
```kconfig
#
# Generic thermal sysfs drivers configuration
#

config HORAE_THERMAL_SHELL
	  tristate "Horae shell temp driver"
	  default y
	  help
	    Provide three thermal zones(front, frame and back) to get real shell temp.

config OPLUS_IPA_THERMAL
	  tristate "oplus ipa thermal sensor driver"
	  depends on HORAE_THERMAL_SHELL
	  default n
	  help
	    the driver of oplus virtual ipa sensor
```

## vendor/oplus/kernel/device_info/device_info/Kconfig
```kconfig
config OPLUS_DEVICE_IFNO
  tristate "config oplus devinfo software"
  help
    define this config to compile devinfo.c for device register

config OPLUS_DEVICE_INFO_MTK_PLATFORM
    bool "OPLUS platform device info module used"
    help
      Say Y here if you have mtk-platform.
```

## vendor/oplus/kernel/dfr/Kconfig
```kconfig
# SPDX-License-Identifier: GPL-2.0-only
# Copyright (C) 2018-2022 Oplus. All rights reserved.

#ifdef OPLUS_FEATURE_PMIC_MONITOR
source "drivers/soc/oplus/dfr/qcom/qcom_pmic_monitor/Kconfig"
#endif /* OPLUS_FEATURE_PMIC_MONITOR */

#ifdef OPLUS_FEATURE_FORCE_SHUTDOWN
source "drivers/soc/oplus/dfr/qcom/force_shutdown/Kconfig"
#endif /* OPLUS_FEATURE_FORCE_SHUTDOWN */

#ifdef OPLUS_FEATURE_QCOM_PMICWD
source "drivers/soc/oplus/dfr/qcom/qcom_pmicwd/Kconfig"
#endif /* OPLUS_FEATURE_QCOM_PMICWD */

#ifdef OPLUS_FEATURE_QCOM_WATCHDOG
source "drivers/soc/oplus/dfr/qcom/qcom_watchdog/Kconfig"
#endif /* OPLUS_FEATURE_QCOM_WATCHDOG */

#ifdef OPLUS_FEATURE_DUMP_REASON
source "drivers/soc/oplus/dfr/qcom/dump_device_info/Kconfig"
#endif /* OPLUS_FEATURE_DUMP_REASON */

#ifdef OPLUS_FEATURE_DUMP_REASON
source "drivers/soc/oplus/dfr/qcom/dump_reason/Kconfig"
#endif /* OPLUS_FEATURE_DUMP_REASON */

#ifdef OPLUS_FEATURE_FULLDUMP_BACK
source "drivers/soc/oplus/dfr/qcom/oplus_ordump/Kconfig"
#endif /* OPLUS_FEATURE_FULLDUMP_BACK */

#ifdef OPLUS_FEATURE_MTK_FORCE_SHUTDOWN
source "drivers/soc/oplus/dfr/mtk/mtk_shutdown_reboot/Kconfig"
#endif /* OPLUS_FEATURE_MTK_FORCE_SHUTDOWN */

#ifdef OPLUS_FEATURE_PMIC_MONITOR_MTK
source "drivers/soc/oplus/dfr/mtk/oplus_pmic_monitor_mtk/Kconfig"
#endif /* OPLUS_FEATURE_PMIC_MONITOR_MTK */

#ifdef OPLUS_FEATURE_SHUTDOWN_DETECT
source "drivers/soc/oplus/dfr/common/shutdown_detect/Kconfig"
#endif /* OPLUS_FEATURE_SHUTDOWN_DETECT */

#ifdef OPLUS_FEATURE_HUNG_TASK_ENHANCE
source "drivers/soc/oplus/dfr/common/hung_task_enhance/Kconfig"
#endif /* OPLUS_FEATURE_HUNG_TASK_ENHANCE */

#ifdef OPLUS_FEATURE_SAUPWK
source "drivers/soc/oplus/dfr/common/oplus_saupwk/Kconfig"
#endif /* OPLUS_FEATURE_SAUPWK */

#ifdef OPLUS_FEATURE_THEIA
source "drivers/soc/oplus/dfr/common/theia/Kconfig"
#endif /* OPLUS_FEATURE_THEIA */

#ifdef OPLUS_FEATURE_INIT_WATCHDOG
source "drivers/soc/oplus/dfr/common/init_watchdog/Kconfig"
#endif /* OPLUS_FEATURE_INIT_WATCHDOG */

#ifdef OPLUS_FEATURE_KEYEVENT_HANDLER
source "drivers/soc/oplus/dfr/common/keyevent_handler/Kconfig"
#endif /* OPLUS_FEATURE_KEYEVENT_HANDLER */

#ifdef OPLUS_FEATURE_COMBKEY_MONITOR
source "drivers/soc/oplus/dfr/common/combkey_monitor/Kconfig"
#endif /* OPLUS_FEATURE_COMBKEY_MONITOR */

#ifdef CONFIG_OPLUS_FEATURE_FAULT_INJECT
source "drivers/soc/oplus/dfr/fault_inject/Kconfig"
#endif /*CONFIG_OPLUS_FEATURE_FAULT_INJECT*/

#ifdef CONFIG_OPLUS_FEATURE_FDLEAK_CHECK
source "drivers/soc/oplus/dfr/common/oplus_fdleak/Kconfig"
#endif /*CONFIG_OPLUS_FEATURE_FDLEAK_CHECK*/

#ifdef CONFIG_OPLUS_BSP_DFR_USERSPACE_BACKTRACE
source "drivers/soc/oplus/dfr/common/oplus_bsp_dfr_ubt/Kconfig"
#endif /* CONFIG_OPLUS_BSP_DFR_USERSPACE_BACKTRACE */

#ifdef OPLUS_FEATURE_LAST_BOOT_REASON
source "drivers/soc/oplus/dfr/common/last_boot_reason/Kconfig"
#endif /*OPLUS_FEATURE_LAST_BOOT_REASON*/
```

## vendor/oplus/kernel/dfr/common/combkey_monitor/Kconfig
```kconfig
# SPDX-License-Identifier: GPL-2.0-only
# Copyright (C) 2022-2030 Oplus. All rights reserved.
config OPLUS_FEATURE_COMBKEY_MONITOR
    tristate "combkey_monitor"
    default n
    help
      define this config to enable combkey_monitor.
```

## vendor/oplus/kernel/dfr/common/keyevent_handler/Kconfig
```kconfig
# SPDX-License-Identifier: GPL-2.0-only
# Copyright (C) 2022-2030 Oplus. All rights reserved.
config OPLUS_FEATURE_KEYEVENT_HANDLER
    tristate "generic keyevent_handler"
    default n
    help
      define this config to enable generic keyevent_handler.
```

## vendor/oplus/kernel/dfr/common/oplus_bsp_dfr_ubt/Kconfig
```kconfig
# SPDX-License-Identifier: GPL-2.0-only
# Copyright (C) 2023-2030 Oplus. All rights reserved.
config OPLUS_BSP_DFR_USERSPACE_BACKTRACE
	tristate "dump userspace backtrace"
	default n
	help
            OPLUS_BSP_DFR_USERSPACE_BACKTRACE is the kernel config of dump userspace
            process backtrace designed by OPLUS.
```

## vendor/oplus/kernel/dfr/fault_inject/Kconfig
```kconfig
# SPDX-License-Identifier: GPL-2.0-only
# Copyright (C) 2018-2022 Oplus. All rights reserved.

#ifdef OPLUS_FEATURE_FAULT_INJECT 
source "drivers/soc/oplus/dfr/fault_inject/common/Kconfig"
#endif /* OPLUS_FEATURE_FAULT_INJECT */

#ifdef CONFIG_OPLUS_FEATURE_FAULT_INJECT_VIBRATOR
source "drivers/soc/oplus/dfr/fault_inject/vibrator/Kconfig"
#endif /* OPLUS_FEATURE_FAULT_INJECT_VIBRATOR */

#ifdef CONFIG_OPLUS_FEATURE_FAULT_INJECT_AW8692X
source "drivers/soc/oplus/dfr/fault_inject/vibrator/Kconfig"
#endif /* CONFIG_OPLUS_FEATURE_FAULT_INJECT_AW8692X */

#ifdef CONFIG_OPLUS_FEATURE_FAULT_INJECT_CHG
source "drivers/soc/oplus/dfr/fault_inject/charger/Kconfig"
#endif
```

## vendor/oplus/kernel/dfr/fault_inject/charger/Kconfig
```kconfig
# SPDX-License-Identifier: GPL-2.0-only
# Copyright (C) 2022-2022 Oplus. All rights reserved.

config OPLUS_FEATURE_FAULT_INJECT_CHG
	tristate "charger driver fault inject"
	default n
	depends on OPLUS_FEATURE_FAULT_INJECT
	help
	  charger driver inject.
```

## vendor/oplus/kernel/dfr/fault_inject/common/Kconfig
```kconfig
# SPDX-License-Identifier: GPL-2.0-only
# Copyright (C) 2018-2020 Oplus. All rights reserved.
config OPLUS_FEATURE_FAULT_INJECT
	tristate "device fault inject"
	default n
	depends on OPLUS_SYSTEM_KERNEL
	help
            framework for device fault inject.

config OPLUS_FEATURE_FAULT_INJECT_SAMPLE
	tristate "device fault inject sample"
	default n
	depends on OPLUS_FEATURE_FAULT_INJECT
	help
            using charger interfce designed sample fault inject.
```

## vendor/oplus/kernel/dfr/fault_inject/vibrator/Kconfig
```kconfig
# SPDX-License-Identifier: GPL-2.0-only
# Copyright (C) 2018-2022 Oplus. All rights reserved.

config OPLUS_FEATURE_FAULT_INJECT_VIBRATOR
	tristate "device haptics fault inject"
	default n
	depends on OPLUS_FEATURE_FAULT_INJECT
	help
            using haptics designed fault inject.

config OPLUS_FEATURE_FAULT_INJECT_AW8692X
	tristate "device haptics fault inject"
	default n
	depends on OPLUS_FEATURE_FAULT_INJECT
	help
            using haptics designed fault inject.
```

## vendor/oplus/kernel/dfr/mtk/mtk_shutdown_reboot/Kconfig
```kconfig
# SPDX-License-Identifier: GPL-2.0-only
# Copyright (C) 2018-2020 Oplus. All rights reserved.
config OPLUS_FEATURE_MTK_FORCE_SHUTDOWN
  tristate "mtk pmic custom made"
  default n
  help
    define this config to mtk pmic custom made
```

## vendor/oplus/kernel/dfr/mtk/oplus_pmic_monitor_mtk/Kconfig
```kconfig
# SPDX-License-Identifier: GPL-2.0-only
# Copyright (C) 2018-2021 Oplus. All rights reserved.
#change 'y' to 'n', if you want fo close pmic monitor
config OPLUS_FEATURE_PMIC_MONITOR_MTK
    tristate "oplus pmic monitor for MTK"
    default n
    help
      define this config to init oplus pmic monitor mtk.
```

## vendor/oplus/kernel/dfr/qcom/force_shutdown/Kconfig
```kconfig
# SPDX-License-Identifier: GPL-2.0-only
# Copyright (C) 2018-2021 Oplus. All rights reserved.
config OPLUS_FEATURE_FORCE_SHUTDOWN
	tristate "force shutdown"
	default n
	depends on OPLUS_SYSTEM_KERNEL
	help
            define this config to enable force shutdown feature.
```

## vendor/oplus/kernel/dft/Kconfig
```kconfig
# SPDX-License-Identifier: GPL-2.0-only
# Copyright (C) 2020-2030 Oplus. All rights reserved.

# Qcom platform feature

# MTK platform feature

# common feature
source "drivers/soc/oplus/dft/common/feedback/Kconfig"
source "drivers/soc/oplus/dft/common/olc/Kconfig"
```

## vendor/oplus/kernel/ear/oplus_bt_ear/Kconfig
```kconfig
# SPDX-License-Identifier: GPL-2.0-only
# Copyright (C) 2020-2022 Oplus. All rights reserved.

config OPLUS_FEATURE_BT_EAR
	tristate "Add for oplus sla function"
	help
	  Add for oplus sla function.
```

## vendor/oplus/kernel/ear/oplus_ear_control/Kconfig
```kconfig
# SPDX-License-Identifier: GPL-2.0-only
# Copyright (C) 2020-2022 Oplus. All rights reserved.

config OPLUS_FEATURE_EAR_CONTROL
	tristate "Add for oplus ear spi slave function"
	help
	 Add for oplus ear spi slave function.
```

## vendor/oplus/kernel/explorer/Kconfig
```kconfig
#
# Explorer IPC drivers configuration
#

config EXPLORER_IPC
	  tristate "Explorer IPC driver"
	  default y
	  help
	    Provide IPC driver for Explorer.
```

## vendor/oplus/kernel/framework_stability/oplus_stability_helper/Kconfig
```kconfig
# SPDX-License-Identifier: GPL-2.0-only
# Copyright (C) 2023-2030 Oplus. All rights reserved.

config OPLUS_FEATURE_STABILITY_HELPER
    tristate "oplus stability helper"
    default n
    help
      framework stability kernel hook helper
```

## vendor/oplus/kernel/hans/Kconfig
```kconfig
#ifdef OPLUS_FEATURE_HANS_FREEZE
config OPLUS_FEATURE_HANS
	tristate "HANS kernel and HANS native communication channel"
	default n
	help
	  Key events (signal/network package/binder) report to HAS native.

config OPLUS_FEATURE_HANS_GKI
	tristate "HANS kernel and HANS native communication channel for MTK"
	default n
	help
	  Key events (signal/network package/binder) report to HAS native.
#endif /*OPLUS_FEATURE_HANS_FREEZE*/
```
