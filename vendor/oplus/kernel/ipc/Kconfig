## vendor/oplus/kernel/ipc/Kconfig
```kconfig
# SPDX-License-Identifier: GPL-2.0-only
# Copyright (C) 2018-2020 Oplus. All rights reserved.

config OPLUS_BINDER_STRATEGY
	tristate "binder optimization strategy"
	default n
	help
	  Customized binder optimization strategy.

config OPLUS_BINDER_PRIO_SKIP
	bool "config binder prio skip"
	default n
	depends on OPLUS_BINDER_STRATEGY
	help
	  Define this config for skip binder_transaction_priority.
	  When a RT thread A do binder transaction with a cfs thread B,
	  the priority of A will be set to the same as B (cfs).
	  So it will affect the performance of A thread,
	  so skip priority set during binder transaction in some situation.

config OPLUS_BINDER_TRANS_CTRL
	bool "binder transaction ctrl"
	default n
	depends on OPLUS_BINDER_STRATEGY
	help
	  With this config, binder threads in target proc will deal with important work first.
```

## vendor/oplus/kernel/mm/Kconfig
```kconfig
# SPDX-License-Identifier: GPL-2.0-only
# Copyright (C) 2018-2020 Oplus. All rights reserved.

config OPLUS_FEATURE_PERFORMANCE_MM
	bool "config oplus kernel mm feature"
	default y
	help
	  define this config to add oplus kernel mm feature

config OPLUS_FEATURE_ZRAM_OPT
	tristate "zram optimization"
	default n
	help
	  define this config to add oplus zram optimization feature

config KSHRINK_SLABD
	tristate "memload optimization"
	default n
	help
	  define this config to add oplus memload optimization feature

config KSHRINK_LRUVECD
	tristate "shrink lruvecd"
	default n
	help
	  define this config to add shrink lruvecd

config PCPPAGES_OPT
	tristate "pcppages_opt"
	default n
	help
	  pcppages_opt

config MAPPED_PROTECT
	tristate "mapped_protect"
	default n
	help
	  mapped_protect

config MAPPED_PROTECT_ALL
	bool "mapped_protect shirnk_inactive_lru"
	depends on MAPPED_PROTECT
	default n
	help
	  mapped_protect_all

config PROCESS_RECLAIM_ENHANCE
	tristate "Enable process reclaim enchance"
	depends on PROC_FS
	default n
	help
	  It allows to reclaim different type pages.
	  Call ioctl of /proc/prpocess_reclaim to get memory range,
	  such as struct iovec.
	  Then call process_madvise() to reclaim or read-ahead memory.

config DUMP_TASKS_MEM
	tristate "dump all userspace process meminfo"
	default n
	help
	  dump all userspace process meminfo

config DYNAMIC_TUNING_SWAPPINESS
	bool "tuning swappiess depends on file_pages size"
	default y
	help
	  Tuning swappiess depends on file_pages size.
	  If the file pages too much, kswapd will reclaim more file pages,
	  and support two levels.
	  Say N if you not sure.

config OPLUS_BALANCE_ANON_FILE_RECLAIM
	bool "During reclaim treat anon and file backed pages equally"
	depends on SWAP
	help
	  When performing memory reclaim treat anonymous and file backed pages
	  equally.
	  Swapping anonymous pages out to memory can be efficient enough to justify
	  treating anonymous and file backed pages equally.

source "mm/oplus_mm/hybridswap_zram/Kconfig"

source "mm/oplus_mm/mm_osvelte/Kconfig"
```

## vendor/oplus/kernel/mm/dynamic_readahead/Kconfig
```kconfig
config OPLUS_FEATURE_DYNAMIC_READAHEAD
	depends on OPLUS_FEATURE_SCHED_ASSIST && OPLUS_FEATURE_CPU_JANKINFO
	tristate "dynamic pagecache readahead"
	default n
	help
	  This driver used for dynamically tuning filemap readahead for performance.
```

## vendor/oplus/kernel/mm/hybridswap_zram/Kconfig
```kconfig
# SPDX-License-Identifier: GPL-2.0
config HYBRIDSWAP_ZRAM
	tristate "Compressed RAM block device support"
	depends on BLOCK && SYSFS && HYBRID_ZSMALLOC && CRYPTO && !ZRAM
	depends on CRYPTO_LZO || CRYPTO_ZSTD || CRYPTO_LZ4 || CRYPTO_LZ4HC || CRYPTO_842
	help
	  Creates virtual block devices called /dev/zramX (X = 0, 1, ...).
	  Pages written to these disks are compressed and stored in memory
	  itself. These disks allow very fast I/O and compression provides
	  good amounts of memory savings.

	  It has several use cases, for example: /tmp storage, use as swap
	  disks and maybe many more.

	  See Documentation/admin-guide/blockdev/zram.rst for more information.

config HYBRIDSWAP_ZRAM_WRITEBACK
       bool "Write back incompressible or idle page to backing device"
       depends on HYBRIDSWAP_ZRAM
       help
	 With incompressible page, there is no memory saving to keep it
	 in memory. Instead, write it out to backing device.
	 For this feature, admin should set up backing device via
	 /sys/block/zramX/backing_dev.

	 With /sys/block/zramX/{idle,writeback}, application could ask
	 idle page's writeback to the backing device to save in memory.

	 See Documentation/admin-guide/blockdev/zram.rst for more information.

config CRYPTO_ZSTDN
	tristate "Zstd compression algorithm"
	select CRYPTO_ALGAPI
	select CRYPTO_ACOMP2
	help
	  This is the zstd algorithm.

config HYBRID_ZSMALLOC
	tristate "Memory allocator for compressed pages"
	depends on MMU
	help
	  zsmalloc is a slab-based memory allocator designed to store
	  compressed RAM pages.  zsmalloc uses virtual memory mapping
	  in order to reduce fragmentation.  However, this results in a
	  non-standard allocator interface where a handle, not a pointer, is
	  returned by an alloc().  This handle must be mapped in order to
	  access the allocated space.

config HYBRIDSWAP_ZRAM_MEMORY_TRACKING
	bool "Track zRam block status"
	depends on HYBRIDSWAP_ZRAM && DEBUG_FS
	help
	  With this feature, admin can track the state of allocated blocks
	  of zRAM. Admin could see the information via
	  /sys/kernel/debug/zram/zramX/block_state.

	  See Documentation/admin-guide/blockdev/zram.rst for more information.

config HYBRIDSWAP
	bool "Enable Hybridswap"
	depends on MEMCG && HYBRIDSWAP_ZRAM && !HYBRIDSWAP_ZRAM_WRITEBACK
	default n
	help
	  Hybridswap is a intelligent memory management solution.

config HYBRIDSWAP_SWAPD
	bool "Enable hybridswap swapd thread to reclaim anon pages in background"
	default n
	depends on HYBRIDSWAP
	help
	  swapd is a kernel thread that reclaim anonymous pages in the
	  background. When the use of swap pages reaches the watermark
	  and the refault of anonymous pages is high, the content of
	  zram will exchanged to eswap by a certain percentage.

# Selected when system need hybridswap container
config HYBRIDSWAP_CORE
	bool "Hybridswap container device support"
	depends on HYBRIDSWAP_ZRAM && HYBRIDSWAP && !HYBRIDSWAP_ZRAM_WRITEBACK
	default n
	help
	  Say Y here if you want to use the hybridswap
	  as the backend device in ZRAM.
	  If unsure, say N here.
	  This module can't be compiled as a module,
	  the module is as one part of the ZRAM driver.
```

## vendor/oplus/kernel/mm/thp_zsmalloc/Kconfig
```kconfig
# SPDX-License-Identifier: GPL-2.0
config THP_ZSMALLOC
	tristate "Memory allocator for compressed pages and hugepage"
	depends on MMU
	default n
	help
	  zsmalloc is a slab-based memory allocator designed to store
	  compressed RAM pages.  zsmalloc uses virtual memory mapping
	  in order to reduce fragmentation.  However, this results in a
	  non-standard allocator interface where a handle, not a pointer, is
	  returned by an alloc().  This handle must be mapped in order to
	  access the allocated space.
```

## vendor/oplus/kernel/mm/uxmem_opt/Kconfig
```kconfig
config OPLUS_FEATURE_UXMEM_OPT
	depends on OPLUS_FEATURE_SCHED_ASSIST
	tristate "enable uxmem_opt"
	default n
	help
	  This feature add a memory pool for ux process.
```

## vendor/oplus/kernel/power/freeze_debug/Kconfig
```kconfig
config OPLUS_FREEZE_DEBUG
	tristate "freeze debug logging"
	default n
	help
	  This selects to provide node for open log,
	  when freezing tasks failed during suspend
```

## vendor/oplus/kernel/power/procs_load/Kconfig
```kconfig
#change 'y' to 'n', if you want fo close this controller
config OPLUS_POWER_PROCS_LOAD
    bool "oplus power procs cpu usage stats feature"
    default n
    help
      define this config to enable oplus power procs cpu usage stats feature.
```

## vendor/oplus/kernel/secureguard/gki2.0/rootguard/Kconfig
```kconfig
# SPDX-License-Identifier: GPL-3.0-only
config OPLUS_KERNEL_SECURE_GUARD
    tristate "oplus kernel secure guard"
    help
        This is the master switch of OPLUS_KERNEL_HARDENING, say N will turn off the compilation
        function of this repository.

config OPLUS_FEATURE_SECURE_ROOTGUARD
    tristate "oplus kernel root_check"
    help
        define this config to enable root_check of kernel on tracepoint hook. Say n will disable
        the function,

config OPLUS_FEATURE_SECURE_EXECGUARD
    tristate "oplus kernel exec guard"
    help
        define this config to enable kernel execve check on tracepoint hook. Say n will disable
        the function,

config OPLUS_FEATURE_SECURE_CAPGUARD
    tristate "oplus kernel cap guard"
    help
        define this config to enable capa check of kernel on tracepoint hook. Say n will disable
        the function,

config OPLUS_FEATURE_SECURE_SRGUARD
    tristate "oplus kernel sepolicy reload guard"
    help
        define this config to enable sepolicy reload  check of kernel on kretprobe. Say n will
        disable the function,
        
config OPLUS_FEATURE_SECURE_SOCKETGUARD
    tristate "oplus kernel socket guard"
    help
        define this config to enable heap-spary  check of kernel on kretprobe. Say n will disable
        the function,
```

## vendor/oplus/kernel/synchronize/Kconfig
```kconfig
# SPDX-License-Identifier: GPL-2.0-only
# Copyright (C) 2020-2022 Oplus. All rights reserved.

config OPLUS_LOCKING_STRATEGY
	tristate "locking strategy"
	default n
	help
	  Customized locking optimization strategy.

config OPLUS_LOCKING_OSQ
	bool "osq control"
	default n
	help
	  Customized mutex & rwsem osq logic.

config OPLUS_LOCKING_MONITOR
	bool "locking stats monitor"
	default n
	help
	  Tracing kernel-lock statistics.

config OPLUS_INTERNAL_VERSION
	bool "internal version"
	depends on OPLUS_LOCKING_MONITOR
	default n
	help
	  Support more tracing-types in internal version.
```

## vendor/oplus/kernel/touchpanel/oplus_touchscreen/Focal/ft3658u/Kconfig
```kconfig
config TOUCHPANEL_FOCAL_FT3658U
	tristate "TP focal ft3658u IC enable or not for OPLUS"
	help
	Say Y to enable driver for Touchpanel using Focal ft3658u
	Say M to enable driver for Touchpanel using Focal ft3658u as module
```

## vendor/oplus/kernel/touchpanel/oplus_touchscreen/chipone/icnl9911c/Kconfig
```kconfig
config TOUCHPANEL_CHIPONE_ICNL9911C
	bool "TP CHIPONE_INGL9911C IC enable or not for OPLUS"
	---help---
	say Y to enable driver for Touchpanel using CHIPONE ICNL9911C
```

## vendor/oplus/kernel/touchpanel/oplus_touchscreen_v2/Goodix/GT9916/Kconfig
```kconfig
config TOUCHPANEL_GOODIX_GT9916
#   default y
    tristate "TP goodix gt9916 IC enable or not for OPLUS"
    help
    Say Y to enable driver for Touchpanel useing goodix gt9916
    Say M to enable driver for Touchpanel useing goodix gt9916 as module
```

## vendor/oplus/kernel/touchpanel/oplus_touchscreen_v2/Goodix/GT9966/Kconfig
```kconfig
config TOUCHPANEL_GOODIX_GT9966
#   default y
    tristate "TP goodix gt9966 IC enable or not for OPLUS"
    help
    Say Y to enable driver for Touchpanel useing goodix gt9966
    Say M to enable driver for Touchpanel useing goodix gt9966 as module
```

## vendor/oplus/kernel/touchpanel/oplus_touchscreen_v2/Goodix/Kconfig
```kconfig
source "drivers/input/touchscreen/oplus_touchscreen_v2/Goodix/GT9886/Kconfig"
source "drivers/input/touchscreen/oplus_touchscreen_v2/Goodix/GT9966/Kconfig"
source "drivers/input/touchscreen/oplus_touchscreen_v2/Goodix/GT9916/Kconfig"
```

## vendor/oplus/kernel/touchpanel/oplus_touchscreen_v2/Himax/hx83102j_noflash/Kconfig
```kconfig
#ifdef OPLUS_FEATURE_TP_BASIC

config TOUCHPANEL_HIMAX_HX83102J_NOFLASH
#	default y
	tristate "TP himax hx83102j no-flash IC enable or not for OPLUS"
	help
	Say Y to enable driver for Touchpanel useing himax hx83102j no-flash
	Say M to enable driver for Touchpanel useing himax hx83102j no-flash as module

#endif
```

## vendor/oplus/kernel/touchpanel/oplus_touchscreen_v2/Novatek/Kconfig
```kconfig
source "drivers/input/touchscreen/oplus_touchscreen_v2/Novatek/NT36672C_noflash/Kconfig"
source "drivers/input/touchscreen/oplus_touchscreen_v2/Novatek/NT36523_noflash/Kconfig"
source "drivers/input/touchscreen/oplus_touchscreen_v2/Novatek/NT36532_noflash/Kconfig"
```

## vendor/oplus/kernel/touchpanel/oplus_touchscreen_v2/Novatek/NT36523_noflash/Kconfig
```kconfig
config TOUCHPANEL_NOVA_NT36523_NOFLASH
#	default y
	tristate "TP nova nt36523 IC enable or not for OPLUS"
	help
	Say Y to enable driver for Touchpanel useing nova nt36523
	Say O to enable driver for Touchpanel useing nova nt36523 as module

config TOUCHPANEL_NT_PEN_SUPPORT
	default n
	depends on TOUCHPANEL_NOVA_NT36523_NOFLASH
	bool "TP nova nt36523 IC enable pen support"
	help
	Say Y if nt36523 IC enable pen support
	Say O to enable driver for Touchpanel useing nova nt36672 as module
```

## vendor/oplus/kernel/touchpanel/oplus_touchscreen_v2/Novatek/NT36532_noflash/Kconfig
```kconfig
config TOUCHPANEL_NOVA_NT36532_NOFLASH
#	default y
	tristate "TP nova nt36532 IC enable or not for OPLUS"
	help
	Say Y to enable driver for Touchpanel useing nova nt36532
	Say O to enable driver for Touchpanel useing nova nt36532 as module
```

## vendor/oplus/kernel/touchpanel/oplus_touchscreen_v2/Synaptics/Syna_tcm_S3910/Kconfig
```kconfig
#
# Synaptics TCM touchscreen driver configuration
#
config TOUCHPANEL_SYNAPTICS_TCM_S3910
    tristate "TP Synaptics_tcm_S3910 enable or not"
    help
      Say Y here if you have a Synaptics TCM touchscreen connected
      to your system.

      If unsure, say N.
```

## vendor/oplus/kernel/touchpanel/touchpanel_notify/Kconfig
```kconfig
config TOUCHPANEL_NOTIFY
    tristate "touch notify"
    help
      Say Y here if you have touchscreen notify build into driver.
      Say M here if you have touchscreen notify as module.
```

## vendor/oplus/kernel/wifi/oplus_wificapcenter/Kconfig
```kconfig
# SPDX-License-Identifier: GPL-2.0-only
# Copyright (C) 2020-2022 Oplus. All rights reserved.

config OPLUS_FEATURE_WIFI_CAPCENTER
	tristate "Add for Oplus Wifi capability center"
	help
	  Add for Oplus Wifi capability center.

config OPLUS_FEATURE_WIFI_OPLUSWFD
	tristate "Add for OplusWFD"
	help
	  Add for Add for OplusWFD.
```

## vendor/oplus/sensor/kernel/oplus_virtual_sensor/sensors/back_tap_detecthub/Kconfig
```kconfig
config OPLUS_FEATURE_BACK_TAP_DETECT
    bool "back_tap_detect for MediaTek package"
    default n
```

## vendor/oplus/sensor/kernel/oplus_virtual_sensor/sensors/lay_detecthub/Kconfig
```kconfig
config OPLUS_FEATURE_LAY_DETECT
	bool "lay_detecthub for MediaTek package"
	default n
```
